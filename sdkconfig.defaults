## sdkconfig.defaults
```kconfig
# set faster freertos ticks:
CONFIG_FREERTOS_HZ=1000
# enable exceptions:
CONFIG_COMPILER_CXX_EXCEPTIONS=y
CONFIG_COMPILER_CXX_EXCEPTIONS_EMG_POOL_SIZE=0
CONFIG_ESP_SYSTEM_EVENT_TASK_STACK_SIZE=3072
```
